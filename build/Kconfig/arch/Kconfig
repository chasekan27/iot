## build/Kconfig/arch/Kconfig
```kconfig
# Load Zephyr Arch Kconfig descriptions.
osource "/home/chasekan/zephyrproject/zephyr/arch/rx/Kconfig"
osource "/home/chasekan/zephyrproject/zephyr/arch/x86/Kconfig"
osource "/home/chasekan/zephyrproject/zephyr/arch/xtensa/Kconfig"
osource "/home/chasekan/zephyrproject/zephyr/arch/sparc/Kconfig"
osource "/home/chasekan/zephyrproject/zephyr/arch/riscv/Kconfig"
osource "/home/chasekan/zephyrproject/zephyr/arch/posix/Kconfig"
osource "/home/chasekan/zephyrproject/zephyr/arch/mips/Kconfig"
osource "/home/chasekan/zephyrproject/zephyr/arch/arm64/Kconfig"
osource "/home/chasekan/zephyrproject/zephyr/arch/arm/Kconfig"
osource "/home/chasekan/zephyrproject/zephyr/arch/arc/Kconfig"
```

## build/Kconfig/boards/Kconfig
```kconfig
# Load Zephyr board Kconfig descriptions.
osource "/home/chasekan/zephyrproject/zephyr/boards/st/nucleo_f411re/Kconfig"
```

## build/Kconfig/boards/Kconfig.defconfig
```kconfig
# Load Zephyr board defconfig descriptions.
osource "/home/chasekan/zephyrproject/zephyr/boards/st/nucleo_f411re/Kconfig.defconfig"
```

## build/Kconfig/boards/Kconfig.sysbuild
```kconfig
# Load Sysbuild board Kconfig descriptions.
osource "/home/chasekan/zephyrproject/zephyr/boards/st/nucleo_f411re/Kconfig.sysbuild"
```
